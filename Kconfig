## Kconfig
```kconfig
DT_COMPAT_ZMK_JOYSTICK_LISTENER := zmk,joystick-listener
config ZMK_JOYSTICK_LISTENER
		bool
		default $(dt_compat_enabled,$(DT_COMPAT_ZMK_JOYSTICK_LISTENER))
    select INPUT
```

## dts/bindings/zmk,joystick-listener.yaml
```yaml
# Copyright (c) 2020 The ZMK Contributors
# SPDX-License-Identifier: MIT

description: |
  Listener to subscribe to input events and send HID updates after processing

compatible: "zmk,joystick-listener"

properties:
  device:
    type: phandle
    required: true
```

## dts/bindings/zmk,joystick.yaml
```yaml
# Copyright (c) 2020 The ZMK Contributors
# SPDX-License-Identifier: MIT

description: |
  Listener to subscribe to input events and send HID updates after processing

compatible: "zmk,joystick"

properties:
  device:
    type: phandle
    required: true
```
